## buildroot-external/Config.in
```kconfig
source "$BR2_EXTERNAL_DIFIW_PATH/package/difiw-shell/Config.in"
source "$BR2_EXTERNAL_DIFIW_PATH/package/difiw-desktop/Config.in"
source "$BR2_EXTERNAL_DIFIW_PATH/package/difiw-netsurf/Config.in"
```

## buildroot-external/configs/difiw_x86_64_defconfig
```kconfig
BR2_x86_64=y
BR2_TOOLCHAIN_BUILDROOT_GLIBC=y
BR2_TOOLCHAIN_BUILDROOT_CXX=y
BR2_TARGET_GENERIC_HOSTNAME="difiw"
BR2_TARGET_GENERIC_ISSUE="Difiw OS 0.5.6 Core"
BR2_TARGET_GENERIC_ROOT_PASSWD=""
BR2_ROOTFS_OVERLAY="$(BR2_EXTERNAL_DIFIW_PATH)/board/difiw/x86_64/overlay"
BR2_ROOTFS_POST_BUILD_SCRIPT="$(BR2_EXTERNAL_DIFIW_PATH)/board/difiw/x86_64/post-build.sh"
BR2_ROOTFS_POST_IMAGE_SCRIPT="$(BR2_EXTERNAL_DIFIW_PATH)/board/difiw/x86_64/post-image.sh"
BR2_LINUX_KERNEL=y
BR2_LINUX_KERNEL_DEFCONFIG="x86_64"
BR2_LINUX_KERNEL_CONFIG_FRAGMENT_FILES="$(BR2_EXTERNAL_DIFIW_PATH)/board/difiw/x86_64/linux.fragment"
BR2_LINUX_KERNEL_BZIMAGE=y
BR2_PACKAGE_BUSYBOX_CONFIG_FRAGMENT_FILES="$(BR2_EXTERNAL_DIFIW_PATH)/board/difiw/x86_64/busybox.fragment"
BR2_PACKAGE_KBD=y
BR2_PACKAGE_E2FSPROGS=y
BR2_PACKAGE_OPENSSL=y
BR2_PACKAGE_LIBOPENSSL=y
BR2_PACKAGE_CA_CERTIFICATES=y
BR2_PACKAGE_LIBCURL=y
BR2_PACKAGE_LIBCURL_CURL=y
BR2_PACKAGE_LIBCURL_OPENSSL=y
BR2_PACKAGE_ALSA_UTILS=y
BR2_PACKAGE_ALSA_UTILS_APLAY=y
BR2_PACKAGE_ALSA_UTILS_ARECORD=y
BR2_PACKAGE_ALSA_UTILS_AMIXER=y
BR2_PACKAGE_DIFIW_SHELL=y
BR2_PACKAGE_DIFIW_DESKTOP=y
# BR2_TARGET_ROOTFS_TAR is not set
BR2_TARGET_ROOTFS_CPIO=y
BR2_TARGET_ROOTFS_CPIO_GZIP=y
# Libraries for the NetSurf web engine
BR2_PACKAGE_LIBPNG=y
BR2_PACKAGE_JPEG=y
BR2_PACKAGE_LIBJPEG_TURBO=y
BR2_PACKAGE_FREETYPE=y
BR2_PACKAGE_EXPAT=y
BR2_PACKAGE_ZLIB=y
BR2_PACKAGE_DEJAVU=y
BR2_PACKAGE_PKGCONF=y
# --- 0.5.6: libraries that libcef.so (Chromium 156) links against ---
BR2_PACKAGE_LIBGLIB2=y
BR2_PACKAGE_LIBNSS=y
BR2_PACKAGE_DBUS=y
BR2_PACKAGE_AT_SPI2_CORE=y
BR2_PACKAGE_CUPS=y
BR2_PACKAGE_LIBXKBCOMMON=y
BR2_PACKAGE_CAIRO=y
BR2_PACKAGE_PANGO=y
BR2_PACKAGE_FONTCONFIG=y
BR2_PACKAGE_ALSA_LIB=y
BR2_PACKAGE_LIBUDEV_ZERO=y
BR2_PACKAGE_XORG7=y
BR2_PACKAGE_XLIB_LIBX11=y
BR2_PACKAGE_XLIB_LIBXCOMPOSITE=y
BR2_PACKAGE_XLIB_LIBXDAMAGE=y
BR2_PACKAGE_XLIB_LIBXEXT=y
BR2_PACKAGE_XLIB_LIBXFIXES=y
BR2_PACKAGE_XLIB_LIBXRANDR=y
BR2_PACKAGE_LIBXCB=y
BR2_PACKAGE_MESA3D=y
BR2_PACKAGE_MESA3D_GALLIUM_DRIVER_SOFTPIPE=y
BR2_PACKAGE_MESA3D_OPENGL_EGL=y
BR2_PACKAGE_MESA3D_GBM=y
BR2_PACKAGE_DIFIW_NETLINE=y
```

## buildroot-external/package/difiw-desktop/Config.in
```kconfig
config BR2_PACKAGE_DIFIW_DESKTOP
	bool "difiw-desktop"
	depends on BR2_INSTALL_LIBSTDCPP
	select BR2_PACKAGE_DIFIW_SHELL
	help
	  Difiw desktop: compositor and shell (floating dock, D menu,
	  background tasks, windows) plus the test applications.
	  Software rendering on the Linux framebuffer; apps run as
	  separate unprivileged users with their own homes.

comment "difiw-desktop needs a toolchain w/ C++"
	depends on !BR2_INSTALL_LIBSTDCPP
```

## buildroot-external/package/difiw-netline/Config.in
```kconfig
config BR2_PACKAGE_DIFIW_NETLINE
	bool "difiw-netline"
	depends on BR2_TOOLCHAIN_USES_GLIBC
	depends on BR2_INSTALL_LIBSTDCPP
	select BR2_PACKAGE_HOST_CMAKE
	select BR2_PACKAGE_LIBNSS
	select BR2_PACKAGE_LIBGLIB2
	select BR2_PACKAGE_DBUS
	select BR2_PACKAGE_AT_SPI2_CORE
	select BR2_PACKAGE_CUPS
	select BR2_PACKAGE_LIBXKBCOMMON
	select BR2_PACKAGE_CAIRO
	select BR2_PACKAGE_PANGO
	select BR2_PACKAGE_FONTCONFIG
	select BR2_PACKAGE_ALSA_LIB
	select BR2_PACKAGE_LIBUDEV_ZERO
	select BR2_PACKAGE_MESA3D_GBM
	select BR2_PACKAGE_DEJAVU
	help
	  Netline: the Difiw OS web browser (Chromium Embedded Framework, off-screen rendering).
```

## buildroot-external/package/difiw-netsurf/Config.in
```kconfig
config BR2_PACKAGE_DIFIW_NETSURF
	bool "difiw-netsurf"
	depends on BR2_PACKAGE_DIFIW_DESKTOP
	select BR2_PACKAGE_LIBCURL
	select BR2_PACKAGE_LIBPNG
	select BR2_PACKAGE_JPEG
	select BR2_PACKAGE_FREETYPE
	select BR2_PACKAGE_EXPAT
	select BR2_PACKAGE_DEJAVU
	help
	  NetSurf 3.11 web engine (CSS layout, HTTPS, images, forms) with a
	  libnsfb surface that draws into a Difiw desktop window.
	  Built by scripts/netsurf-build.sh (needs flex, bison, gperf, perl
	  and libpng headers on the build host).
```

## buildroot-external/package/difiw-shell/Config.in
```kconfig
config BR2_PACKAGE_DIFIW_SHELL
	bool "difiw-shell"
	depends on BR2_INSTALL_LIBSTDCPP
	help
	  Difiw Shell - the interactive shell of Difiw OS (C++17,
	  linked statically against musl).

comment "difiw-shell needs a toolchain w/ C++"
	depends on !BR2_INSTALL_LIBSTDCPP
```
